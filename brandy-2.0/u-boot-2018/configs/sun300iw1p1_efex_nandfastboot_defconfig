## brandy-2.0/u-boot-2018/configs/sun300iw1p1_efex_nandfastboot_defconfig
```kconfig
CONFIG_RISCV=y
CONFIG_SYS_CONFIG_NAME="sun300iw1p1"
CONFIG_SYS_TEXT_BASE=0x82000000
CONFIG_SUNXI_SECURE_BOOT=y
CONFIG_SUNXI_FDT_ADDR=0x81fe0000
CONFIG_CPU_E90X=y
CONFIG_SUNXI_ANTI_BRUSH=y
CONFIG_MACH_SUN300IW1=y
CONFIG_AW_CLIC=y
CONFIG_SUNXI_RISCV_MODE=y
CONFIG_XIP=y
CONFIG_DEFAULT_DEVICE_TREE="sun300iw1p1-soc-system"
# CONFIG_SYS_MALLOC_CLEAR_ON_INIT is not set
CONFIG_ANDROID_BOOT_IMAGE=y
CONFIG_CONSOLE_MUX=y
CONFIG_RESERVE_FDT_SIZE=0x20000
CONFIG_ARCH_EARLY_INIT_R=y
CONFIG_SUNXI_SERIAL=y
CONFIG_SUNXI_MALLOC_LEN=0x1400000
CONFIG_SUNXI_MAC=y
CONFIG_SUNXI_USER_KEY=y
CONFIG_SUNXI_NECESSARY_REPLACE_FDT=y
CONFIG_SUNXI_COMP_DETECT=y
CONFIG_SUNXI_EFEX_IMG=y
CONFIG_CMD_FASTBOOT=y
# CONFIG_CMD_GPT is not set
CONFIG_CMD_PART=y
CONFIG_CMD_SUNXI_TIMER=y
CONFIG_CMD_SUNXI_SPRITE=y
CONFIG_CMD_SUNXI_BURN=y
CONFIG_CMD_SUNXI_BOOTR=y
CONFIG_EFI_PARTITION=y
CONFIG_CLK_SUNXI=y
CONFIG_SUNXI_DMA=y
CONFIG_SUNXI_GPIO_V2=y
CONFIG_MMC=y
CONFIG_AW_MTD_SPINAND=y
CONFIG_AW_MTD_SPINAND_FASTBOOT=y
CONFIG_SPI_FLASH=y
CONFIG_SF_DEFAULT_MODE=0x3000
CONFIG_SF_DEFAULT_SPEED=30000000
CONFIG_SPI_SAMP_DL_EN=y
CONFIG_SPI_FLASH_ATMEL=y
CONFIG_SPI_FLASH_EON=y
CONFIG_SPI_FLASH_GIGADEVICE=y
CONFIG_SPI_FLASH_ISSI=y
CONFIG_SPI_FLASH_MACRONIX=y
CONFIG_SPI_FLASH_SPANSION=y
CONFIG_SPI_FLASH_STMICRO=y
CONFIG_SPI_FLASH_SST=y
CONFIG_SPI_FLASH_WINBOND=y
CONFIG_SPI_FLASH_XMC=y
CONFIG_SPI_FLASH_PUYA=y
CONFIG_SPI_FLASH_FM=y
CONFIG_SPI_FLASH_XT=y
CONFIG_BAUDRATE=115200
CONFIG_SPI=y
CONFIG_SUNXI_SPI=y
CONFIG_SUNXI_SPIF=y
CONFIG_SUNXI_NAND=y
CONFIG_SUNXI_UBIFS=y
CONFIG_SUNXI_SDMMC=y
CONFIG_SUNXI_USB=y
CONFIG_SUNXI_EFEX=y
CONFIG_SUNXI_BURN=y
CONFIG_NOT_USE_OPTEE25=y
CONFIG_SHA256=y
CONFIG_SUNXI_SPRITE=y
CONFIG_SUNXI_SPRITE_CARTOON=y
CONFIG_SUNXI_AUTO_UPDATE=y
CONFIG_SUNXI_BOOT_PARAM=y
```

## brandy-2.0/u-boot-2018/configs/sun300iw1p1_min_nor_defconfig
```kconfig
CONFIG_RISCV=y
CONFIG_SYS_CONFIG_NAME="sun300iw1p1"
CONFIG_SYS_TEXT_BASE=0x82000000
CONFIG_ENV_SIZE=0x10000
CONFIG_SUNXI_FDT_ADDR=0x81fe0000
CONFIG_SUNXI_NOR_IMG=y
CONFIG_RISCV_NDS=y
CONFIG_CPU_A27L2=y
CONFIG_MACH_SUN300IW1=y
CONFIG_SUNXI_RISCV_MODE=y
CONFIG_DEFAULT_DEVICE_TREE="sun300iw1p1-soc-system"
# CONFIG_SYS_MALLOC_CLEAR_ON_INIT is not set
CONFIG_ANDROID_BOOT_IMAGE=y
# CONFIG_LEGACY_IMAGE_FORMAT is not set
CONFIG_CONSOLE_MUX=y
CONFIG_RESERVE_FDT_SIZE=0x20000
CONFIG_SUNXI_SERIAL=y
CONFIG_SUNXI_MALLOC_LEN=0x600000
CONFIG_SUNXI_MAC=y
CONFIG_SUNXI_NECESSARY_REPLACE_FDT=y
CONFIG_SUNXI_COMP_DETECT=y
# CONFIG_CMD_BOOTI is not set
# CONFIG_CMD_GPT is not set
CONFIG_CMD_PART=y
CONFIG_CMD_SF=y
CONFIG_CMD_SF_TEST=y
# CONFIG_CMD_SOURCE is not set
# CONFIG_CMD_SETEXPR is not set
# CONFIG_CMD_MISC is not set
CONFIG_CMD_FAT=y
CONFIG_CMD_SUNXI_TIMER=y
# CONFIG_CMD_SUNXI_PWM is not set
CONFIG_CMD_SUNXI_BOOTR=y
CONFIG_EFI_PARTITION=y
CONFIG_CLK_SUNXI=y
# CONFIG_CPU is not set
CONFIG_SUNXI_DMA=y
CONFIG_SUNXI_GPIO_V2=y
CONFIG_MMC=y
CONFIG_SIMULATE_MULTIPLANE=y
CONFIG_SPI_FLASH=y
CONFIG_SF_DEFAULT_MODE=0x3000
CONFIG_SF_DEFAULT_SPEED=30000000
CONFIG_SPI_SAMP_DL_EN=y
CONFIG_SPI_FLASH_ATMEL=y
CONFIG_SPI_FLASH_EON=y
CONFIG_SPI_FLASH_GIGADEVICE=y
CONFIG_SPI_FLASH_ISSI=y
CONFIG_SPI_FLASH_MACRONIX=y
CONFIG_SPI_FLASH_SPANSION=y
CONFIG_SPI_FLASH_STMICRO=y
CONFIG_SPI_FLASH_SST=y
CONFIG_SPI_FLASH_WINBOND=y
CONFIG_SPI_FLASH_XMC=y
CONFIG_SPI_FLASH_PUYA=y
CONFIG_SPI_FLASH_FM=y
CONFIG_SPI_FLASH_XT=y
CONFIG_BAUDRATE=115200
CONFIG_SPI=y
CONFIG_SUNXI_SPI=y
CONFIG_SUNXI_SPIF=y
CONFIG_SUNXI_FLASH=y
CONFIG_NOT_USE_OPTEE25=y
CONFIG_SUNXI_SBI_ECALL=y
CONFIG_FAT_WRITE=y
CONFIG_LZ4=y
CONFIG_LZMA=y
CONFIG_LZO=y
```

## brandy-2.0/u-boot-2018/configs/sun300iw1p1_v821_uart3_disp_nor_defconfig
```kconfig
CONFIG_RISCV=y
CONFIG_SYS_CONFIG_NAME="sun300iw1p1"
CONFIG_SYS_TEXT_BASE=0x82000000
CONFIG_SUNXI_SECURE_BOOT=y
CONFIG_SUNXI_FDT_ADDR=0x81fe0000
CONFIG_SUNXI_NOR_IMG=y
CONFIG_I2C0_ENABLE=y
CONFIG_RISCV_NDS=y
CONFIG_CPU_A27L2=y
CONFIG_SUNXI_ANTI_BRUSH=y
CONFIG_MACH_SUN300IW1=y
CONFIG_SUNXI_BOOTPKG_BASE=0x80000000
CONFIG_SUNXI_RISCV_MODE=y
CONFIG_DEFAULT_DEVICE_TREE="sun300iw1p1-soc-system"
# CONFIG_SYS_MALLOC_CLEAR_ON_INIT is not set
CONFIG_ANDROID_BOOT_IMAGE=y
CONFIG_CONSOLE_MUX=y
CONFIG_RESERVE_FDT_SIZE=0x20000
CONFIG_SUNXI_SERIAL=y
CONFIG_SUNXI_MALLOC_LEN=0x600000
CONFIG_SUNXI_MAC=y
CONFIG_SUNXI_USER_KEY=y
CONFIG_SUNXI_ADVERT_PICTURE=y
CONFIG_SUNXI_NECESSARY_REPLACE_FDT=y
CONFIG_SUNXI_COMP_DETECT=y
CONFIG_CMD_FASTBOOT=y
# CONFIG_CMD_GPT is not set
CONFIG_CMD_PART=y
CONFIG_CMD_USB=y
CONFIG_CMD_SUNXI_TIMER=y
CONFIG_CMD_SUNXI_SPRITE=y
CONFIG_CMD_SUNXI_BURN=y
CONFIG_CMD_SUNXI_AUTO_FEL=y
CONFIG_CMD_SUNXI_BOOTR=y
CONFIG_EFI_PARTITION=y
CONFIG_SUNXI_REDUNDAND_ENVIRONMENT=y
# CONFIG_CPU is not set
CONFIG_SUNXI_DMA=y
CONFIG_SUNXI_GPIO_V2=y
CONFIG_SYS_I2C_SUNXI=y
CONFIG_SYS_SUNXI_I2C0_SPEED=400000
CONFIG_SYS_SUNXI_I2C0_SLAVE=0x62
CONFIG_MMC=y
CONFIG_AW_MTD_SPINAND=y
CONFIG_SIMULATE_MULTIPLANE=y
CONFIG_SPI_FLASH=y
CONFIG_SF_DEFAULT_MODE=0x3000
CONFIG_SF_DEFAULT_SPEED=30000000
CONFIG_SPI_SAMP_DL_EN=y
CONFIG_SPI_FLASH_ATMEL=y
CONFIG_SPI_FLASH_EON=y
CONFIG_SPI_FLASH_GIGADEVICE=y
CONFIG_SPI_FLASH_ISSI=y
CONFIG_SPI_FLASH_MACRONIX=y
CONFIG_SPI_FLASH_SPANSION=y
CONFIG_SPI_FLASH_STMICRO=y
CONFIG_SPI_FLASH_SST=y
CONFIG_SPI_FLASH_WINBOND=y
CONFIG_SPI_FLASH_XMC=y
CONFIG_SPI_FLASH_PUYA=y
CONFIG_SPI_FLASH_FM=y
CONFIG_SPI_FLASH_XT=y
CONFIG_BAUDRATE=115200
CONFIG_CONS_INDEX=4
CONFIG_SPI=y
CONFIG_SUNXI_SPI=y
CONFIG_SUNXI_SPIF=y
CONFIG_SUNXI_POWER=y
CONFIG_SUNXI_PMU=y
CONFIG_SUNXI_BMU=y
CONFIG_AXPNULL_POWER=y
CONFIG_AXP2601_POWER=y
CONFIG_SUNXI_UBOOT_POWER_OFF=y
CONFIG_SUNXI_GPIO_NOT_CTRL_BY_POWER=y
CONFIG_USB=y
CONFIG_USB_EHCI_HCD=y
CONFIG_USB_STORAGE=y
CONFIG_USB_HOST_ETHER=y
CONFIG_BOOT_GUI=y
# CONFIG_CONFIG_LCD_CHECK_SKIP_OPEN is not set
CONFIG_CMD_SUNXI_BMP=y
CONFIG_DISP2_SUNXI=y
# CONFIG_LCD_SUPPORT_HE0801A068 is not set
CONFIG_LCD_SUPPORT_T27P06=y
# CONFIG_LCD_SUPPORT_WILLIAMLCD is not set
# CONFIG_LCD_SUPPORT_LQ101R1SX03 is not set
# CONFIG_LCD_SUPPORT_INET_DSI_PANEL is not set
CONFIG_SUNXI_NAND=y
CONFIG_SUNXI_UBIFS=y
CONFIG_SUNXI_SDMMC=y
CONFIG_SUNXI_USB=y
CONFIG_SUNXI_EFEX=y
CONFIG_NOT_USE_OPTEE25=y
CONFIG_SUNXI_SBI_ECALL=y
CONFIG_CRYPTO=y
CONFIG_SHA256=y
CONFIG_LZ4=y
CONFIG_SUNXI_SPRITE=y
CONFIG_SUNXI_SPRITE_CARTOON=y
CONFIG_SUNXI_AUTO_UPDATE=y
```

## brandy-2.0/u-boot-2018/drivers/riscv/Kconfig
```kconfig
config BOOT_RISCV
	bool "Support RISCV"
	default n

config CLEAR_BSS_FOR_RISCV
	bool "Support Clear bss data for RISCV"
	depends on BOOT_RISCV
	default n

config RISCV_UPDATA_IRQ_TAB
	bool "Support RISCV share irq table updata"
	depends on BOOT_RISCV
	default n

config RISCV_UPDATA_IRQ_TAB_DEBUG
	bool "Support RISCV share irq table updata debug log"
	depends on RISCV_UPDATA_IRQ_TAB
	default n
```
